## arch/arm/configs/embedsky_tq210_defconfig
```kconfig
CONFIG_AEABI=y
CONFIG_TEXT_BASE=0x2ff00000
CONFIG_ARCH_S5PCxx=y
CONFIG_MACH_TQ210=y
CONFIG_S3C_PLL_INIT=y
CONFIG_CMD_LED=y
CONFIG_CMD_LED_TRIGGER=y
CONFIG_LED=y
CONFIG_LED_GPIO=y
CONFIG_LED_TRIGGERS=y
CONFIG_NET=y
CONFIG_DRIVER_NET_DM9K=y
CONFIG_CMD_PING=y
CONFIG_FS_TFTP=y
CONFIG_CMD_TFTP=y
CONFIG_CMD_RESET=y
CONFIG_CMDLINE_EDITING=y
CONFIG_AUTO_COMPLETE=y
CONFIG_DEFAULT_ENVIRONMENT=y
CONFIG_DEFAULT_ENVIRONMENT_PATH="arch/arm/boards/embedsky-tq210/env"
CONFIG_CMD_TIMEOUT=y
CONFIG_CMD_EXPORT=y
CONFIG_CMD_MAGICVAR=y
CONFIG_CMD_MAGICVAR_HELP=y
CONFIG_CMD_ECHO_E=y
CONFIG_HUSH_FANCY_PROMPT=y
CONFIG_MTD=y
CONFIG_NAND=y
CONFIG_NAND_S5PCXX=y
CONFIG_LONGHELP=y
CONFIG_CMD_SAVEENV=y
CONFIG_CMD_EDIT=y
CONFIG_CMD_FLASH=y
CONFIG_S5PCXX_NAND_BOOT=y
CONFIG_CMD_BAREBOX_UPDATE=y
CONFIG_MALLOC_SIZE=0x4000000
CONFIG_VIDEO=y
CONFIG_FRAMEBUFFER_CONSOLE=y
CONFIG_DRIVER_VIDEO_S3C=y
CONFIG_CMD_SPLASH=y
CONFIG_CMD_FBTEST=y
CONFIG_BMP=y
CONFIG_PBL_IMAGE=y
CONFIG_IMAGE_COMPRESSION_XZKERN=y
CONFIG_ARM_OPTIMZED_STRING_FUNCTIONS=y
CONFIG_BOOTM_SHOW_TYPE=y
CONFIG_BOOTM_VERBOSE=y
CONFIG_CMD_MEMINFO=y
# CONFIG_CMD_BOOTU is not set
# CONFIG_CMD_PWD is not set
CONFIG_NET_NFS=y
CONFIG_FS_NFS=y
CONFIG_NET_NETCONSOLE=y
CONFIG_NET_RESOLV=y
CONFIG_NET_DHCP=y
CONFIG_CMD_DHCP=y
CONFIG_CMD_HOST=y
CONFIG_CMD_MIITOOL=y
CONFIG_CMD_LOGIN=y
CONFIG_CMD_PASSWD=y
CONFIG_PASSWD_MODE_STAR=y
CONFIG_MENU=y
CONFIG_CMD_MENU=y
CONFIG_CMD_MENUTREE=y
CONFIG_CMD_MENU_MANAGEMENT=y
```

## arch/arm/configs/forlinx_ok210_defconfig
```kconfig
CONFIG_AEABI=y
CONFIG_ARCH_S5PCxx=y
CONFIG_MACH_OK210=y
CONFIG_S3C_PLL_INIT=y
CONFIG_CMD_LED=y
CONFIG_CMD_LED_TRIGGER=y
CONFIG_LED=y
CONFIG_LED_GPIO=y
CONFIG_LED_TRIGGERS=y
CONFIG_NET=y
CONFIG_DRIVER_NET_DM9K=y
CONFIG_CMD_PING=y
CONFIG_FS_TFTP=y
CONFIG_CMD_TFTP=y
CONFIG_CMD_RESET=y
CONFIG_CMDLINE_EDITING=y
CONFIG_AUTO_COMPLETE=y
CONFIG_DEFAULT_ENVIRONMENT=y
CONFIG_DEFAULT_ENVIRONMENT_GENERIC_NEW=y
CONFIG_DEFAULT_ENVIRONMENT_PATH="arch/arm/boards/embedsky-tq210/env"
CONFIG_CMD_TIMEOUT=y
CONFIG_CMD_EXPORT=y
CONFIG_CMD_MAGICVAR=y
CONFIG_CMD_MAGICVAR_HELP=y
CONFIG_CMD_ECHO_E=y
CONFIG_HUSH_FANCY_PROMPT=y
CONFIG_LONGHELP=y
CONFIG_CMD_GO=y
CONFIG_CMD_EDIT=y
CONFIG_MALLOC_SIZE=0x4000000
CONFIG_DEBUG_LL=y
```

## arch/mips/configs/general-ar9331_defconfig
```kconfig
CONFIG_BUILTIN_DTB=y
CONFIG_BUILTIN_DTB_NAME="general-ar9331"
CONFIG_BOARD_GENERAL_AR9331=y
CONFIG_MACH_MIPS_ATH79=y
CONFIG_PBL_IMAGE=y
CONFIG_IMAGE_COMPRESSION_XZKERN=y
CONFIG_MMU=y
CONFIG_TEXT_BASE=0x81000000
CONFIG_MALLOC_TLSF=y
CONFIG_HUSH_FANCY_PROMPT=y
CONFIG_CMDLINE_EDITING=y
CONFIG_AUTO_COMPLETE=y
CONFIG_DEFAULT_ENVIRONMENT_PATH="arch/mips/boards/general-ar9331/env"
CONFIG_FS_TFTP=y
CONFIG_CMD_DMESG=y
CONFIG_LONGHELP=y
CONFIG_CMD_IOMEM=y
CONFIG_CMD_MEMINFO=y
CONFIG_CMD_GO=y
CONFIG_CMD_LOADY=y
CONFIG_CMD_RESET=y
CONFIG_CMD_EXPORT=y
CONFIG_CMD_DEFAULTENV=y
CONFIG_CMD_NV=y
CONFIG_CMD_GLOBAL=y
CONFIG_CMD_LOADENV=y
CONFIG_CMD_MAGICVAR=y
CONFIG_CMD_MAGICVAR_HELP=y
CONFIG_CMD_SAVEENV=y
CONFIG_CMD_LET=y
CONFIG_CMD_MSLEEP=y
CONFIG_CMD_READF=y
CONFIG_CMD_SLEEP=y
CONFIG_CMD_DHCP=y
CONFIG_CMD_MIITOOL=y
CONFIG_CMD_PING=y
CONFIG_CMD_ECHO_E=y
CONFIG_CMD_EDIT=y
CONFIG_CMD_TIMEOUT=y
CONFIG_CMD_MM=y
CONFIG_CMD_FLASH=y
CONFIG_CMD_GPIO=y
CONFIG_CMD_LED=y
CONFIG_CMD_SPI=y
CONFIG_CMD_BAREBOX_UPDATE=y
CONFIG_CMD_TIME=y
CONFIG_CMD_TFTP=y
CONFIG_CMD_CLK=y
CONFIG_CMD_PARTITION=y
CONFIG_NET=y
CONFIG_NET_NETCONSOLE=y
CONFIG_OFDEVICE=y
CONFIG_OF_BAREBOX_DRIVERS=y
CONFIG_OF_BAREBOX_ENV_IN_FS=y
CONFIG_DRIVER_SERIAL_AR933X=y
CONFIG_DRIVER_NET_AG71XX=y
CONFIG_DRIVER_SPI_ATH79=y
CONFIG_MTD=y
# CONFIG_MTD_OOB_DEVICE is not set
CONFIG_MTD_M25P80=y
CONFIG_LED=y
CONFIG_LED_GPIO=y
CONFIG_LED_GPIO_OF=y
CONFIG_LED_TRIGGERS=y
# CONFIG_CMD_IP_ROUTE_GET is not set
# CONFIG_CMD_CAT is not set
# CONFIG_CMD_MKDIR is not set
# CONFIG_CMD_PWD  is not set
# CONFIG_CMD_READLINK is not set
# CONFIG_CMD_RMDIR is not set
# CONFIG_CMD_DIRNAME is not set
# CONFIG_CMD_BASENAME is not set
# CONFIG_CMD_MOUNT is not set
# CONFIG_CMD_UMOUNT is not set
```

## arch/mips/mach-ralink/Kconfig
```kconfig
if MACH_MIPS_RALINK

config ARCH_TEXT_BASE
	hex
	default 0xa0800000

config SOC_RT305X
	bool

choice
	prompt "Board type"

config BOARD_GENERAL_RT5350
	bool "General RT5350 Board"
	select SOC_RT305X
	select HAVE_PBL_IMAGE
	select HAVE_IMAGE_COMPRESSION
	select HAS_NMON

endchoice

endif
```

## drivers/net/mtk/Kconfig
```kconfig
config DRIVER_NET_MEDIATEK
	tristate "Mediatek/Ralink ethernet driver"
	depends on MACH_MIPS_RALINK
	help
	  This driver supports the ethernet mac inside the Mediatek and Ralink WiSoCs

config NET_MEDIATEK_SOC
	def_tristate DRIVER_NET_MEDIATEK

if NET_MEDIATEK_SOC
choice
	prompt "MAC type"

config NET_MEDIATEK_RT3050
	bool "RT3050/MT7628"
	depends on MIPS && SOC_RT305X

endchoice

config NET_MEDIATEK_ESW_RT3050
	def_tristate NET_MEDIATEK_SOC
	depends on NET_MEDIATEK_RT3050

endif
```

## net/picotcp/Kconfig
```kconfig
if NET_PICOTCP

config NET_PICO_SUPPORT_ETH
	bool
	default y

config NET_PICO_SUPPORT_IPV4
	bool
	default y

config NET_PICO_SUPPORT_MCAST
	bool
	default y

if NET_PICO_SUPPORT_IPV4

config NET_PICO_SUPPORT_IPV4FRAG
	bool "ip fragmentation support"

config NET_PICO_SUPPORT_ICMP4
	bool "icmp support"

config NET_PICO_SUPPORT_TCP
	bool "tcp support"

config NET_PICO_SUPPORT_UDP
	bool "udp support"

config NET_PICO_SUPPORT_DEVLOOP
	bool "loopback device support"

config NET_PICO_SUPPORT_DHCP_CLIENT
	bool "dhcp client support"

config NET_PICO_SUPPORT_DHCP_SERVER
	bool "dhcp server support"

config NET_PICO_SUPPORT_TFTP
	bool "tftp support"

endif

endif
```
